/*
  Smart AC & Fan Controller — website server (web only, no hardware yet)

  What it does: connects the ESP32 to your Wi-Fi and serves the website from its
  own flash memory. Open  http://<ESP32 IP>/  (or http://smart-ac.local/) on a
  phone or laptop connected to the same Wi-Fi.

  Works on ESP32 AND ESP8266 (NodeMCU, Wemos D1 mini, ...). Needs no extra libraries,
  only the board package for your chip (esp32 or esp8266 by ESP8266 Community).
  The website files live in web_files.h (generated by ../build_web_header.py).

  If it cannot join your Wi-Fi within 15 s it starts its own hotspot instead:
      network  SmartAC-Setup   password  12345678   ->  http://192.168.4.1/

  Settings and profiles are saved in each phone's browser (localStorage) for now.
*/

#if defined(ESP8266)
  #include <ESP8266WiFi.h>
  #include <ESP8266WebServer.h>
  #include <ESP8266mDNS.h>
  typedef ESP8266WebServer WebServerClass;
#else
  #include <WiFi.h>
  #include <WebServer.h>
  #include <ESPmDNS.h>
  typedef WebServer WebServerClass;
#endif
#include "web_files.h"

// ======== EDIT THESE ========
const char* WIFI_SSID = "YOUR_WIFI_NAME";
const char* WIFI_PASS = "YOUR_WIFI_PASSWORD";
const char* HOSTNAME  = "smart-ac";          // reachable as http://smart-ac.local/
const char* AP_SSID   = "SmartAC-Setup";     // fallback hotspot
const char* AP_PASS   = "CHANGE_ME_8CHARS";         // at least 8 characters
// ============================

WebServerClass server(80);

// Serve one of the embedded (gzip-compressed) website files.
void handleWeb() {
  String path = server.uri();
  if (path == "/") path = "/index.html";

  for (size_t i = 0; i < WEB_FILE_COUNT; i++) {
    if (path == WEB_FILES[i].path) {
      server.sendHeader("Content-Encoding", "gzip");
      server.sendHeader("Cache-Control", "no-cache");
      server.send_P(200, WEB_FILES[i].type, (PGM_P)WEB_FILES[i].data, WEB_FILES[i].len);
      return;
    }
  }
  server.send(404, "text/plain", "404 - not found: " + path);
}

// Prints why joining failed: is the network visible, on which band, and the status code.
void explainWifiFailure() {
  Serial.printf("Wi-Fi status code: %d (1=network not found, 4=connection failed, 6=wrong password)\n", WiFi.status());
  Serial.println("Scanning for networks the ESP32 can see (it only supports 2.4 GHz)...");
  int n = WiFi.scanNetworks();
  bool found = false;
  for (int i = 0; i < n; i++) {
    Serial.printf("  %-32s  channel %2d  signal %d dBm\n", WiFi.SSID(i).c_str(), WiFi.channel(i), WiFi.RSSI(i));
    if (WiFi.SSID(i) == WIFI_SSID) found = true;
  }
  if (n == 0) Serial.println("  (no networks found)");
  if (found) Serial.println("-> Your network IS visible, so the password is most likely wrong.");
  else Serial.println("-> Your network is NOT visible: check the name (case-sensitive), turn the hotspot on first, and set it to 2.4 GHz.");
  WiFi.scanDelete();
}

void startWifi() {
  WiFi.mode(WIFI_STA);
#if defined(ESP8266)
  WiFi.hostname(HOSTNAME);
#else
  WiFi.setHostname(HOSTNAME);
#endif
  WiFi.begin(WIFI_SSID, WIFI_PASS);

  Serial.printf("Connecting to Wi-Fi \"%s\"", WIFI_SSID);
  uint32_t start = millis();
  while (WiFi.status() != WL_CONNECTED && millis() - start < 15000) {
    delay(300);
    Serial.print('.');
  }
  Serial.println();

  if (WiFi.status() == WL_CONNECTED) {
    Serial.print("Connected. Open the website at:  http://");
    Serial.println(WiFi.localIP());
    return;
  }

  Serial.println("Could not join Wi-Fi, starting hotspot instead.");
  explainWifiFailure();
  WiFi.disconnect(true);
  WiFi.mode(WIFI_AP);
  WiFi.softAP(AP_SSID, AP_PASS);
  Serial.printf("Join Wi-Fi \"%s\" (password %s), then open:  http://", AP_SSID, AP_PASS);
  Serial.println(WiFi.softAPIP());
}

void setup() {
  Serial.begin(115200);
  delay(300);
  Serial.println();
  Serial.println("Smart AC & Fan Controller - website server");

  startWifi();

  if (MDNS.begin(HOSTNAME)) {
    MDNS.addService("http", "tcp", 80);
    Serial.printf("Also reachable at  http://%s.local/\n", HOSTNAME);
  }

  server.onNotFound(handleWeb);   // "/" and every website file go through here
  server.begin();
  Serial.println("Web server started.");
}

void loop() {
#if defined(ESP8266)
  MDNS.update();
#endif
  server.handleClient();
}
